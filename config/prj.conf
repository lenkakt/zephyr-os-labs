## CMakeLists.txt
```
cmake_minimum_required(VERSION 3.20.0)

find_package(Zephyr)
project(config)

target_sources(app PRIVATE src/main.c)
```

## sample.yaml
```
sample:
  name: config
  description: Hello from kernel, a trivial example used to demonstrate the configuration options
tests:
  sample.hello:
    tags: kernel
    build-only: true
```

## prj.conf
```kconfig
#CONFIG_BOOT_DELAY=1000
```

## src/main.c
```c
/*
 * Copyright (c) 2012-2014 Wind River Systems, Inc.
 *
 * SPDX-License-Identifier: Apache-2.0
 */

#include <stdio.h>

int main(void)
{
	printf("Hello World! System has booted and it is running. To stop the emulation, press Ctrl+A+X.");
	return 0;
}
```
