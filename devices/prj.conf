## CMakeLists.txt
```
cmake_minimum_required(VERSION 3.20.0)

find_package(Zephyr)
project(devices)

target_sources(app PRIVATE src/main.c)
```

## sample.yaml
```
sample:
  name: devices
  description: The lab demonstrating device trees and device drivers.
tests:
  sample.devices:
    tags: kernel
    build-only: true
```

## prj.conf
```kconfig
#Nothing defined here; waiting for your configurations.
```

## src/main.c
```c
#include <zephyr/kernel.h>

int main(void)
{
	printk("Where is your code?....\n");

}
```
