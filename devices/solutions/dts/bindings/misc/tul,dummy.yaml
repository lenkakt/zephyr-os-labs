## devices/solutions/dts/bindings/misc/tul,dummy.yaml
```yaml
description: Dummy device for the devices lab

compatible: "tul,dummy"

properties:
  foo:
    type: int
    required: true
    description: A number the driver reads from the device tree
```
