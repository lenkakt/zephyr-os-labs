## app_directory/sample.yaml
```yaml
sample:
  name: app_directory
  description: Void "Hello world" just to keep the essential files and folders.
tests:
  sample.app_directory:
    tags: kernel
    build-only: true
```

## devices/solutions/dts/bindings/misc/tul,dummy.yaml
```yaml
# dts/bindings/misc/tul,dummy.yaml
compatible: "tul,dummy"
description: Minimal dummy device for demo
properties:
  foo:
    type: int
    required: true
  label:
    type: string
    required: false
```

## filesystems/sample.yaml
```yaml
sample:
  name: filesystems
  description: Filesystems in Zephyr.
tests:
  sample.filesystems:
    tags: kernel
    build-only: true
```

## memory/sample.yaml
```yaml
sample:
  name: memory
  description: The memory lab.
tests:
  sample.memory:
    tags: kernel
    build-only: true
```

## synchro/sample.yaml
```yaml
sample:
  name: synchro
  description: A lab dedicated to locks and other synchronization.
tests:
  sample.synchro:
    tags: kernel
    build-only: true
```
