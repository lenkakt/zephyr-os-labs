## CMakeLists.txt
```
cmake_minimum_required(VERSION 3.20.0)

find_package(Zephyr)
project(kernel_lab)

target_sources(app PRIVATE src/main.c)
```

## sample.yaml
```
sample:
  name: kernel-lab
  description: A lab dedicated to demonstrate the kernel features.
tests:
  sample.hello:
    tags: kernel
    build-only: true
```

## prj.conf
```kconfig
# Nothing defined here yet.
```

## src/main.c
```c
/*
 * Copyright (c) 2012-2014 Wind River Systems, Inc.
 *
 * SPDX-License-Identifier: Apache-2.0
 */

#include <stdio.h>
#include <zephyr/kernel.h>


int main(void)
{
	printf("The timer application is not working - you must add your code. Stop this emulation by Ctrl+A+X.\n");
	/* This file is waiting for your timer */

	return 0;
}
```
