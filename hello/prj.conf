## CMakeLists.txt
```
cmake_minimum_required(VERSION 3.20.0)

find_package(Zephyr)
project(hello)

target_sources(app PRIVATE src/main.c)
```

## sample.yaml
```
sample:
  name: hello
  description: Hello from kernel, a trivial example for the first Zephyr OS lab.
tests:
  sample.hello:
    tags: kernel
    build-only: true
```

## prj.conf
```kconfig
#CONFIG_BOOT_DELAY=1000
```

## src/main.c
```c
/*
 * Copyright (c) 2012-2014 Wind River Systems, Inc.
 *
 * SPDX-License-Identifier: Apache-2.0
 */

#include <stdio.h>
#include <zephyr/kernel.h>

int main(void)
{
	printf("Hello World!\n");
	return 0;
}
```
