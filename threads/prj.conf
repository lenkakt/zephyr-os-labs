## CMakeLists.txt
```
cmake_minimum_required(VERSION 3.20.0)

find_package(Zephyr)
project(threads)

target_sources(app PRIVATE src/main.c)
```

## sample.yaml
```
sample:
  name: threads
  description: Lab demonstrating working with threads
tests:
  sample.app_directory:
    tags: kernel
    build-only: true
```

## prj.conf
```kconfig
#CONFIG_USERSPACE=y
#CONFIG_ASSERT=y
```

## src/main.c
```c
/*
 * Copyright (c) 2012-2014 Wind River Systems, Inc.
 *
 * SPDX-License-Identifier: Apache-2.0
 */

#include <stdio.h>
#include <zephyr/kernel.h>

int main(void)
{
	printf("This application has no threads yet - you must add your code. Stop this emulation by Ctrl+A+X.\n");
	/* This file is waiting for your first thread (see TASK1.1) */

	return 0;
}
```
